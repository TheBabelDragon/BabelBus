## main/Kconfig.projbuild
```kconfig
menu "BabelBus HDMI → CSI"

    orsource "$IDF_PATH/examples/common_components/env_caps/$IDF_TARGET/Kconfig.env_caps"

    config P4KVM_TC358743_RST_GPIO
        int "TC358743 RESETN GPIO (active low; -1 if unused)"
        range -1 ENV_GPIO_RANGE_MAX
        default 23 if IDF_TARGET_ESP32P4
        default -1
        help
            Wire adapter RESET (active low) here. p4kvm / Waveshare-class boards
            typically use GPIO 23. Use -1 only if RESET is not connected.

    config P4KVM_JPEG_QUALITY
        int "JPEG quality 1-100"
        range 1 100
        default 70

    config P4KVM_TC358743_ADV_DEBUG
        bool "Advanced TC358743 debugging (verbose stall / bridge logs + extra I2C reads)"
        default y
        help
            When enabled, CSI frame timeouts log extra TC358743 register state, AVI
            infoframe dumps, and periodic bridge status. Adds I2C traffic on error paths.

    config P4KVM_ETH_ENABLE
        bool "Enable Ethernet (DHCP)"
        default y
        depends on SOC_EMAC_SUPPORTED

    config P4KVM_MDNS_HOSTNAME
        string "mDNS hostname (device is <name>.local)"
        default "babelbus"
        depends on P4KVM_ETH_ENABLE
        help
            DNS label only: letters, digits, hyphen. Advertised over mDNS and
            sent as the DHCP client hostname when supported.

    config P4KVM_ETH_RMII_CLK_GPIO
        int "RMII REFCLK GPIO (external input)"
        range ENV_GPIO_RANGE_MIN ENV_GPIO_RANGE_MAX
        default 50 if IDF_TARGET_ESP32P4
        default 0
        depends on P4KVM_ETH_ENABLE

    config P4KVM_ETH_RMII_TX_EN_GPIO
        int "RMII TX_EN"
        range ENV_GPIO_RANGE_MIN ENV_GPIO_OUT_RANGE_MAX
        default 49 if IDF_TARGET_ESP32P4
        default 0
        depends on P4KVM_ETH_ENABLE

    config P4KVM_ETH_RMII_TXD0_GPIO
        int "RMII TXD0"
        range ENV_GPIO_RANGE_MIN ENV_GPIO_OUT_RANGE_MAX
        default 34 if IDF_TARGET_ESP32P4
        default 0
        depends on P4KVM_ETH_ENABLE

    config P4KVM_ETH_RMII_TXD1_GPIO
        int "RMII TXD1"
        range ENV_GPIO_RANGE_MIN ENV_GPIO_OUT_RANGE_MAX
        default 35 if IDF_TARGET_ESP32P4
        default 0
        depends on P4KVM_ETH_ENABLE

    config P4KVM_ETH_RMII_CRS_DV_GPIO
        int "RMII CRS_DV"
        range ENV_GPIO_RANGE_MIN ENV_GPIO_IN_RANGE_MAX
        default 28 if IDF_TARGET_ESP32P4
        default 0
        depends on P4KVM_ETH_ENABLE

    config P4KVM_ETH_RMII_RXD0_GPIO
        int "RMII RXD0"
        range ENV_GPIO_RANGE_MIN ENV_GPIO_IN_RANGE_MAX
        default 29 if IDF_TARGET_ESP32P4
        default 0
        depends on P4KVM_ETH_ENABLE

    config P4KVM_ETH_RMII_RXD1_GPIO
        int "RMII RXD1"
        range ENV_GPIO_RANGE_MIN ENV_GPIO_IN_RANGE_MAX
        default 30 if IDF_TARGET_ESP32P4
        default 0
        depends on P4KVM_ETH_ENABLE

    config P4KVM_ETH_MDC_GPIO
        int "SMI MDC"
        range ENV_GPIO_RANGE_MIN ENV_GPIO_OUT_RANGE_MAX
        default 31 if IDF_TARGET_ESP32P4
        default 23
        depends on P4KVM_ETH_ENABLE

    config P4KVM_ETH_MDIO_GPIO
        int "SMI MDIO"
        range ENV_GPIO_RANGE_MIN ENV_GPIO_OUT_RANGE_MAX
        default 52 if IDF_TARGET_ESP32P4
        default 18
        depends on P4KVM_ETH_ENABLE

    config P4KVM_ETH_PHY_ADDR
        int "PHY address (-1 auto)"
        range -1 31
        default 1
        depends on P4KVM_ETH_ENABLE

    config P4KVM_ETH_PHY_RST_GPIO
        int "PHY reset GPIO (-1 none)"
        range -1 ENV_GPIO_OUT_RANGE_MAX
        default 51 if IDF_TARGET_ESP32P4
        default 5
        depends on P4KVM_ETH_ENABLE

    menu "Wi-Fi (ESP32-C6 co-processor)"
        config BABELBUS_WIFI_ENABLE
            bool "Enable Wi-Fi STA via ESP-Hosted / esp_wifi_remote"
            default n
            help
                Waveshare ESP32-P4-WIFI6 boards talk to an onboard ESP32-C6 over SDIO.
                Add components: espressif/esp_hosted and espressif/esp_wifi_remote.
                C6 must run ESP-Hosted slave firmware (factory default on Waveshare).
                2.4 GHz only. Ethernet can stay enabled in parallel.

        config BABELBUS_WIFI_SSID
            string "Wi-Fi SSID"
            default "babelbus"
            depends on BABELBUS_WIFI_ENABLE

        config BABELBUS_WIFI_PASSWORD
            string "Wi-Fi password"
            default "babelbus"
            depends on BABELBUS_WIFI_ENABLE
    endmenu

    menu "I2S audio (HDMI adapter flying leads)"
        config BABELBUS_I2S_AUDIO_ENABLE
            bool "Enable I2S RX from HDMI→CSI adapter"
            default y
            help
                Capture PCM from the adapter's I2S pads (WFS/SD/SCK). Bridge is I2S master;
                P4 runs as I2S slave. Streamed at GET /audio (raw s16le stereo).

        config BABELBUS_I2S_BCLK_GPIO
            int "I2S BCLK GPIO (adapter SCK)"
            range ENV_GPIO_RANGE_MIN ENV_GPIO_IN_RANGE_MAX
            default 20 if IDF_TARGET_ESP32P4
            default 0
            depends on BABELBUS_I2S_AUDIO_ENABLE

        config BABELBUS_I2S_WS_GPIO
            int "I2S WS/LRCK GPIO (adapter WFS)"
            range ENV_GPIO_RANGE_MIN ENV_GPIO_IN_RANGE_MAX
            default 21 if IDF_TARGET_ESP32P4
            default 0
            depends on BABELBUS_I2S_AUDIO_ENABLE

        config BABELBUS_I2S_DIN_GPIO
            int "I2S DIN GPIO (adapter SD)"
            range ENV_GPIO_RANGE_MIN ENV_GPIO_IN_RANGE_MAX
            default 22 if IDF_TARGET_ESP32P4
            default 0
            depends on BABELBUS_I2S_AUDIO_ENABLE
    endmenu

endmenu
```
